## drivers/comparator/Kconfig
```kconfig
menuconfig COMPARATOR
    bool "Comparator drivers"

if COMPARATOR

config COMP_INIT_PRIORITY
	int "COMP init priority"
	default KERNEL_INIT_PRIORITY_DEVICE
	help
	  COMP driver device initialization priority.

module = COMPARATOR
module-str = COMPARATOR
source "subsys/logging/Kconfig.template.log_config"

rsource "Kconfig.stm32"

endif
```

## drivers/comparator/Kconfig.stm32
```kconfig
config COMPARATOR_STM32
	bool "STM32 Comparator Driver"
	default y
	depends on DT_HAS_ST_STM32_COMPARATORS_ENABLED
	select USE_STM32_HAL_COMP
	help
	  Enable the driver implementation for the stm32 COMP

if COMPARATOR_STM32

endif
```

## dts/bindings/comparator/comparator-controller.yaml
```yaml
include: base.yaml

properties:
  zephyr,invert-output:
    type: boolean

  zephyr,input-positive:
    type: int

  zephyr,input-negative:
    type: int

  zephyr,output:
    type: int
```

## dts/bindings/comparator/st,stm32-comparators.yaml
```yaml
description: STM32 COMP

compatible: st,stm32-comparators

include: [comparator-controller.yaml, pinctrl-device.yaml]
```

## dts/bindings/comparator/st,stm32f0-comparator.yaml
```yaml
description: STM32 COMP

compatible: st,stm32f0-comparator

include: [base.yaml, pinctrl-device.yaml]

properties:
  zephyr,invert-output:
    type: boolean

  zephyr,input-noninverting:
    type: int
    description: Non-inverting input selection, must be a value of COMP_NonInvertingInput.
    required: true

  zephyr,input-inverting:
    type: int
    description: Inverting input selection, must be a value of COMP_InvertingInput.
    required: true

  zephyr,output:
    type: int
    description: Optional output to timer peripheral, must be a value of COMP_Output.
```

## west.yml
```yaml
manifest:
  remotes:
    - name: ottojo
      url-base: https://github.com/ottojo

  projects:
    - name: hal_stm32
      remote: ottojo
      revision: comp_pinctrl
      path: modules/hal/stm32
      groups:
        - hal
```
